## Kconfig
```kconfig
# SPDX-License-Identifier: GPL-2.0
#
# For a description of the syntax of this configuration file,
# see Documentation/kbuild/kconfig-language.txt.
#
mainmenu "Linux/$ARCH $KERNELVERSION Kernel Configuration"

config SRCARCH
	string
	option env="SRCARCH"

config GFY
	bool "General (Ret.) Fault Yanky Support"
	default n

	---help---
	Select this option if you want to give your kernel general fault-
	yanking support. This feature utilizes a Language Theoretic NP-Complete
	approach that removes faulty cpu gate arrays from receving signal-high.

	If unsure, say Y

	Turn this off only if you know what you're doing

source "arch/$SRCARCH/Kconfig"
```

## fs/aifs/Kconfig
```kconfig
config AIFS_FS
	tristate "AiFS, a self-healing self-defending filesystems (EXPERIMENTAL)"
	help
	  saf.ai is a stackable file system which provides data resilience
	  and data security layers on top of existing file systems stored in lower layer.
	  (See Documentation/safai-aifs.txt and https://saf.ai/ for details)
	  You must either compile XFS or BTRFS as upper file system
	select OVERLAY_FS
	select XFS_FS
	select BTRFS_FS

config AIFS_DEEP_METRICS
	bool "Enable AIFS deep metrics"
	help 
	  enable deep metrics in saf.ai
	depends on AIFS_FS

config AIFS_DEBUG
	bool "Compile debugging code"
	help
  		Enable kernel-level debugging code in saf.ai (aifs).
       		Really only needed if you are developing aifs 
	depends on AIFS_FS

config AIFS_LEGACY_READ
	bool "Compile legacy read function (DANGEROUS)"
	help
	   leave this disabled unless you really know what you're doing
        depends on AIFS_FS
```
